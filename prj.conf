## CMakeLists.txt
```
# SPDX-License-Identifier: Apache-2.0

cmake_minimum_required(VERSION 3.20.0)

set(CONF_FILE auth.conf prj.conf)

find_package(Zephyr HINTS $ENV{ZEPHYR_BASE})
project(home-assistant-node-esp32)

FILE(GLOB app_sources src/*.c)
target_sources(app PRIVATE ${app_sources})
```

## sample.yaml
```
sample:
  name: Home Assistant Node ESP32
tests:
  sample.board.esp32:
    platform_allow: esp32 esp32s2_saola
    tags: esp32
```

## prj.conf
```kconfig
# Enable support for ESP32 WIFI
CONFIG_WIFI=y
CONFIG_WIFI_ESP32=y
CONFIG_HEAP_MEM_POOL_SIZE=65535
CONFIG_ESP32_WIFI_STA_AUTO=y

CONFIG_MBEDTLS=y
CONFIG_MBEDTLS_ENTROPY_ENABLED=y
CONFIG_MBEDTLS_KEY_EXCHANGE_ECDHE_ECDSA_ENABLED=y
CONFIG_MBEDTLS_ECP_ALL_ENABLED=y
CONFIG_ENTROPY_GENERATOR=y
CONFIG_TEST_RANDOM_GENERATOR=y

# Network stack configurtion
CONFIG_NETWORKING=y
CONFIG_NET_SOCKETS=y
CONFIG_NET_TCP=y
CONFIG_NET_LOG=y
CONFIG_NET_L2_ETHERNET=y
CONFIG_NET_DHCPV4=y
CONFIG_NET_MGMT=y
CONFIG_NET_MGMT_EVENT=y
CONFIG_NET_IPV6=n
CONFIG_NET_IPV4=y
CONFIG_NET_CONFIG_SETTINGS=y
CONFIG_NET_SHELL=n

# Enable the MQTT Lib
CONFIG_MQTT_LIB=y

# App settings:
CONFIG_PRINTK=y
CONFIG_STDOUT_CONSOLE=y
CONFIG_MAIN_STACK_SIZE=2048
CONFIG_JSON_LIBRARY=y
```

## auth.conf
```kconfig
CONFIG_ESP32_WIFI_SSID="ssid"
CONFIG_ESP32_WIFI_PASSWORD="pass"
```

## boards/esp32.conf
```kconfig
CONFIG_LED=y
CONFIG_LED_PWM=y
CONFIG_PWM_LED_ESP32=y
```

## esp32.overlay
```dts
/ {
  aliases {
    led0 = &led0;
  };

  leds {
    compatible = "gpio-leds";
    led0: led_0 {
      gpios = <&gpio0 4 GPIO_ACTIVE_HIGH>;
      label = "LED 0";
    };
  };
};
```

## src/main.c
```c
#include "led.h"
#include "mqtt.h"
#include "messages.h"
#include "sensors.h"
#include "wifi.h"

#include <logging/log.h>
LOG_MODULE_REGISTER(main, LOG_LEVEL_INF);

#include <zephyr.h>

#define MQTT_TOPIC_DATA "nodes/outside/data"
#define MQTT_TOPIC_SET "nodes/outside/set"

static char buffer[1024];

void main(void)
{
  const struct device * ledGreen = ledInit(LED0);
  if(ledGreen == NULL) {
    LOG_ERR("LED init failed!");
    return;
  }

  ledSet(ledGreen, false);

  wifiInit();

  mqttConnect();

  mqttSubscribe(MQTT_TOPIC_SET);

  initSensors();

  while(1) {
    mqttProcess();

    struct SensorsData sensorsData;

    if (getSensorsData(&sensorsData)) {
      LOG_INF("Temperature: %u", sensorsData.temperature);

      const struct MessageNodeData nodeData = {
        .location = "outside",
        .timestamp = "2021-12-18T20:25:46.537Z",
        .sensors = {
          .pms1_0 = sensorsData.pms1_0,
          .pms2_5 = sensorsData.pms2_5,
          .pms10 = sensorsData.pms10,
          .temperature = sensorsData.temperature,
          .humidity = sensorsData.humidity,
        }
      };

      if (messageEncodeNodeData(&nodeData, buffer, sizeof(buffer))) {
        mqttPublish(MQTT_TOPIC_DATA, buffer);
      } else {
        LOG_ERR("Encode JSON failed!");
      }

      ledSet(ledGreen, true);
      k_msleep(100);
      ledSet(ledGreen, false);
    }

    k_msleep(1000);
  }
}
```

## src/led.c
```c
#include "led.h"

#include <logging/log.h>
LOG_MODULE_REGISTER(led, LOG_LEVEL_INF);

#include <drivers/gpio.h>

const struct device * ledInit(const char *name) {
  int ret;

  const struct device *dev = device_get_binding(name);
  if (dev == NULL) {
    LOG_ERR("device_get_binding failed");
    return NULL;
  }

  ret = gpio_pin_configure(dev, PIN, GPIO_OUTPUT_ACTIVE | FLAGS);
  if (ret < 0) {
    LOG_ERR("gpio_pin_configure failed");
    return NULL;
  }

  return dev;
}

void ledSet(const struct device * led, const bool state) {
  gpio_pin_set(led, PIN, (int)state);
}
```

## src/led.h
```c
#ifndef __LED_H__
#define __LED_H__

#include <stdbool.h>
#include <zephyr.h>

/* The devicetree node identifier for the "led0" alias. */
#define LED0_NODE DT_ALIAS(led0)

#if DT_NODE_HAS_STATUS(LED0_NODE, okay)
#define LED0	DT_GPIO_LABEL(LED0_NODE, gpios)
#define PIN	DT_GPIO_PIN(LED0_NODE, gpios)
#define FLAGS	DT_GPIO_FLAGS(LED0_NODE, gpios)
#else
/* A build error here means your board isn't set up to blink an LED. */
#error "Unsupported board: led0 devicetree alias is not defined"
#define LED0	""
#define PIN	0
#define FLAGS	0
#endif

const struct device * ledInit(const char *name);

void ledSet(const struct device * led, const bool state);

#endif
```

## src/messages.c
```c
#include "messages.h"
#include <logging/log.h>
LOG_MODULE_REGISTER(protocol, LOG_LEVEL_DBG);

#include <data/json.h>

static const struct json_obj_descr messageSensorsDataDescriptor[] = {
  JSON_OBJ_DESCR_PRIM(struct MessageSensorsData, pms1_0, JSON_TOK_NUMBER),
  JSON_OBJ_DESCR_PRIM(struct MessageSensorsData, pms2_5, JSON_TOK_NUMBER),
  JSON_OBJ_DESCR_PRIM(struct MessageSensorsData, pms10, JSON_TOK_NUMBER),
  JSON_OBJ_DESCR_PRIM(struct MessageSensorsData, temperature, JSON_TOK_NUMBER),
  JSON_OBJ_DESCR_PRIM(struct MessageSensorsData, humidity, JSON_TOK_NUMBER),
};

static const struct json_obj_descr messageDataDescriptor[] = {
  JSON_OBJ_DESCR_PRIM(struct MessageNodeData, location, JSON_TOK_STRING),
  JSON_OBJ_DESCR_PRIM(struct MessageNodeData, timestamp, JSON_TOK_STRING),
  JSON_OBJ_DESCR_OBJECT(struct MessageNodeData, sensors, messageSensorsDataDescriptor),
};

bool messageEncodeNodeData(const struct MessageNodeData* response, char * const buffer, const size_t bufferSize)
{
  int ret;
  ssize_t len = json_calc_encoded_len(messageDataDescriptor, ARRAY_SIZE(messageDataDescriptor), response);
  LOG_DBG("Required buffer length: %u", len);

  return json_obj_encode_buf(
    messageDataDescriptor,
    ARRAY_SIZE(messageDataDescriptor),
    response,
    buffer,
    bufferSize) == NULL;
}
```

## src/messages.h
```c
#ifndef __MESSAGES_H__
#define __MESSAGES_H__

#include <stdbool.h>
#include <stddef.h>

struct MessageSensorsData
{
  unsigned int pms1_0;
  unsigned int pms2_5;
  unsigned int pms10;
  int temperature;
  unsigned int humidity;
};

struct MessageNodeData
{
  const char *location;
  const char *timestamp;
  const struct MessageSensorsData sensors;
};

bool messageEncodeNodeData(
  const struct MessageNodeData* response,
  char * const buffer,
  const size_t bufferSize);

#endif
```

## src/mqtt.c
```c
#include "mqtt.h"
#include <logging/log.h>
LOG_MODULE_REGISTER(mqtt, LOG_LEVEL_DBG);

#include <random/rand32.h>
#include <net/socket.h>
#include <net/mqtt.h>
#include <esp_event.h>


static uint8_t rx_buffer[1024];
static uint8_t tx_buffer[1024];
static struct mqtt_client mqttClient;
struct mqtt_utf8 app_user_name;
struct mqtt_utf8 app_password;

static struct sockaddr_storage broker;
static struct zsock_pollfd fds[1];
extern int nfds;

#define MQTT_POLL_MSEC	500
#define MQTT_BROKER_IP "192.168.1.4"
#define MQTT_USER ""
#define MQTT_PWD ""

static void prepare_fds(struct mqtt_client *client) {
  if (client->transport.type == MQTT_TRANSPORT_NON_SECURE) {
    fds[0].fd = client->transport.tcp.sock;
  }

  fds[0].events = ZSOCK_POLLIN;
  nfds = 1;
}

static int poll_socks(int timeout) {
  int ret = 0;

  if (nfds > 0) {
    ret = zsock_poll(fds, nfds, timeout);
    if (ret < 0) {
      LOG_ERR("poll error: %d", errno);
    }
  }

  return ret;
}

static void app_mqtt_evt_handler(struct mqtt_client *const client,
          const struct mqtt_evt *evt) {
  struct mqtt_puback_param puback;
  uint8_t data[128];
  int len;
  int bytes_read;
  int err;

  switch (evt->type) {
    case MQTT_EVT_CONNACK:  {
      if (evt->result != 0) {
        LOG_ERR("MQTT connect failed %d", evt->result);
        break;
      }
      LOG_INF("MQTT client connected!");

      break;
    }

    case MQTT_EVT_PUBLISH: {
      len = evt->param.publish.message.payload.len;

      LOG_INF("MQTT publish received %d, %d bytes", evt->result, len);
      LOG_INF(" id: %d, qos: %d", evt->param.publish.message_id,
        evt->param.publish.message.topic.qos);

      while (len) {
        bytes_read = mqtt_read_publish_payload(&mqttClient,
            data,
            len >= sizeof(data) - 1 ?
            sizeof(data) - 1 : len);
        if (bytes_read < 0 && bytes_read != -EAGAIN) {
          LOG_ERR("failure to read payload");
          break;
        }

        data[bytes_read] = '\0';
        LOG_INF("   payload: %s", log_strdup(data));
        len -= bytes_read;
      }

      puback.message_id = evt->param.publish.message_id;
      mqtt_publish_qos1_ack(&mqttClient, &puback);
      break;
    }

    case MQTT_EVT_DISCONNECT: {
      LOG_INF("MQTT client disconnected %d", evt->result);
      break;
    }

    case MQTT_EVT_PUBACK: {
      if (evt->result != 0) {
        LOG_ERR("MQTT PUBACK error %d", evt->result);
        break;
      }
      LOG_INF("PUBACK packet id: %u", evt->param.puback.message_id);
      break;
    }

    case MQTT_EVT_PUBREC: {
      if (evt->result != 0) {
        LOG_ERR("MQTT PUBREC error %d", evt->result);
        break;
      }

      LOG_INF("PUBREC packet id: %u", evt->param.pubrec.message_id);

      const struct mqtt_pubrel_param rel_param = {
        .message_id = evt->param.pubrec.message_id
      };

      err = mqtt_publish_qos2_release(client, &rel_param);
      if (err != 0) {
        LOG_ERR("Failed to send MQTT PUBREL: %d", err);
      }

      break;
    }

    case MQTT_EVT_PUBCOMP: {
      if (evt->result != 0) {
        LOG_ERR("MQTT PUBCOMP error %d", evt->result);
        break;
      }

      LOG_INF("PUBCOMP packet id: %u",
        evt->param.pubcomp.message_id);

      break;
    }

    case MQTT_EVT_SUBACK: {
      LOG_INF("SUBACK packet id: %u", evt->param.suback.message_id);
      break;
    }

    case MQTT_EVT_UNSUBACK: {
      LOG_INF("UNSUBACK packet id: %u", evt->param.suback.message_id);
      break;
    }

    case MQTT_EVT_PINGRESP: {
      LOG_INF("PINGRESP packet");
      break;
    }

    default: {
      LOG_INF("Unhandled MQTT event %d", evt->type);
      break;
    }
  }
}

static void app_mqtt_broker_init(void) {
  struct sockaddr_in *addr = (struct sockaddr_in *)&broker;

  addr->sin_family = AF_INET;
  addr->sin_port = htons(1883);

  zsock_inet_pton(AF_INET, MQTT_BROKER_IP, &addr->sin_addr);
}

static void mqttClientInit(struct mqtt_client *client) {
  mqtt_client_init(client);

  app_mqtt_broker_init();

  app_user_name.utf8 = (const uint8_t *)MQTT_USER;
  app_user_name.size = strlen(app_user_name.utf8);

  app_password.utf8 = (const uint8_t *) MQTT_PWD;
  app_password.size = strlen(app_password.utf8);

  /* MQTT client configuration */
  client->broker = &broker;
  client->evt_cb = app_mqtt_evt_handler;
  client->client_id.utf8 = (const uint8_t *)"nodes/outside";
  client->client_id.size = strlen(client->client_id.utf8);

  client->password = &app_password;
  client->user_name = &app_user_name;
  client->protocol_version = MQTT_VERSION_3_1_1;

  /* MQTT buffers configuration */
  client->rx_buf = rx_buffer;
  client->rx_buf_size = sizeof(rx_buffer);
  client->tx_buf = tx_buffer;
  client->tx_buf_size = sizeof(tx_buffer);

  /* MQTT transport configuration */
  client->transport.type = MQTT_TRANSPORT_NON_SECURE;
}


int mqttConnect() {
  int rc, i = 0;

  mqttClientInit(&mqttClient);

  rc = mqtt_connect(&mqttClient);
  if (rc != 0) {
    return rc;
  }

  prepare_fds(&mqttClient);

  if (poll_socks(MQTT_POLL_MSEC)) {
    mqtt_input(&mqttClient);
  }

  return rc;
}

void mqttProcess() {
  int rc;

  if (poll_socks(MQTT_POLL_MSEC)) {
    rc = mqtt_input(&mqttClient);
    if (rc != 0) {
      return;
    }
  }

  rc = mqtt_live(&mqttClient);
  if (rc != 0 && rc != -EAGAIN) {
    return;
  } else if (rc == 0) {
    rc = mqtt_input(&mqttClient);
    if (rc != 0) {
      return;
    }
  }

  return;
}

void mqttSubscribe(const char* const topicName) {
  int rc;
  struct mqtt_topic topic = {};
  struct mqtt_subscription_list subs_list = {};

  LOG_INF("Subscribe for topic %s", topicName);

  topic.topic.utf8 = (uint8_t *)topicName;
  topic.topic.size = strlen(topic.topic.utf8);
  subs_list.list = &topic;
  subs_list.list_count = 1;
  subs_list.message_id = 1;

  rc = mqtt_subscribe(&mqttClient, &subs_list);
  if (rc) {
    LOG_ERR("Subscribe failed for topic %s", topicName);
  }
}

void mqttPublish(const char* const topicName, char* message) {
  struct mqtt_publish_param param;

  param.message.topic.qos = MQTT_QOS_0_AT_MOST_ONCE;
  param.message.topic.topic.utf8 = (uint8_t *)topicName;
  param.message.topic.topic.size =
      strlen(param.message.topic.topic.utf8);

  param.message.payload.data = message;
  param.message.payload.len =
      strlen(param.message.payload.data);

  param.message_id = sys_rand32_get();
  param.dup_flag = 0U;
  param.retain_flag = 0U;

  LOG_INF("Publish topic: %s, message: %s", topicName, message);

  mqtt_publish(&mqttClient, &param);

  return;
}
```

## src/mqtt.h
```c
#ifndef __MQTT_H__
#define __MQTT_H__

int mqttConnect();

void mqttProcess();

void mqttSubscribe(const char* const topicName);

void mqttPublish(const char* const topicName, char* message);

#endif
```

## src/sensors.c
```c
#include "sensors.h"
#include <logging/log.h>
LOG_MODULE_REGISTER(sensors, LOG_LEVEL_DBG);

#include <zephyr.h>

/* size of stack area used by each thread */
#define STACKSIZE 1024

/* scheduling priority used by each thread */
#define PRIORITY 7

struct k_fifo sensorDataFifo;

struct SensorDataFifoItem {
    void *fifo_reserved;   /* 1st word reserved for use by FIFO */
    struct SensorsData data;
};

K_THREAD_STACK_DEFINE(sensorsThreadStackArea, STACKSIZE);
static struct k_thread sensorsThreadData;

static void sensorsThreadEntry()
{
  const char *tname;
  uint8_t cpu;
  struct k_thread *current_thread;
  int cnt = 0;

  LOG_DBG("SensorsThread started");
  while (1) {
    k_msleep(5000);
    LOG_DBG("Sensors read");

    // TODO: read sensors

    current_thread = k_current_get();
    tname = k_thread_name_get(current_thread);

    static unsigned int cnt = 0;

    struct SensorDataFifoItem dataItem;

    dataItem.data.pms1_0 = 0;
    dataItem.data.pms2_5 = 0;
    dataItem.data.pms10 = 0;
    dataItem.data.temperature = cnt++;
    dataItem.data.humidity = 0;

    k_fifo_put(&sensorDataFifo, &dataItem);
  }
}

void initSensors() {
  k_fifo_init(&sensorDataFifo);

  k_thread_create(&sensorsThreadData, sensorsThreadStackArea,
                  K_THREAD_STACK_SIZEOF(sensorsThreadStackArea),
                  sensorsThreadEntry, NULL, NULL, NULL,
                  PRIORITY, 0, K_FOREVER);
  k_thread_name_set(&sensorsThreadData, "SensorsThread");

  k_thread_start(&sensorsThreadData);
}

bool getSensorsData(struct SensorsData* const data) {
  bool dataAvailable = !k_fifo_is_empty(&sensorDataFifo);

  if (dataAvailable) {
    LOG_DBG("Sensors data available");
    struct SensorDataFifoItem  *rx_data;
    rx_data = k_fifo_get(&sensorDataFifo, K_NO_WAIT);
    memcpy(data, &rx_data->data, sizeof(struct SensorsData));
  }

  return dataAvailable;
}
```

## src/sensors.h
```c
#ifndef __SENSORS_H__
#define __SENSORS_H__

#include <stdbool.h>

struct SensorsData
{
  unsigned int pms1_0;
  unsigned int pms2_5;
  unsigned int pms10;
  int temperature;
  unsigned int humidity;
};

void initSensors();

bool getSensorsData(struct SensorsData* const data);

#endif
```

## src/wifi.c
```c
#include "sensors.h"
#include <logging/log.h>
LOG_MODULE_REGISTER(wifi, LOG_LEVEL_DBG);

#include <net/socket.h>
#include <esp_wifi.h>

static struct net_mgmt_event_callback dhcpCb;
int nfds;

K_SEM_DEFINE(netIfReady, 0, 1);

static void netMgmtEventCb(struct net_mgmt_event_callback *cb,
        uint32_t mgmtEvent, struct net_if *iface)
{
  if (mgmtEvent != NET_EVENT_IPV4_DHCP_BOUND) {
    return;
  }
  k_sem_give(&netIfReady);
}

void wifiInit() {
  struct net_if *interface;

  net_mgmt_init_event_callback(&dhcpCb, netMgmtEventCb,
             NET_EVENT_IPV4_DHCP_BOUND);

  net_mgmt_add_event_callback(&dhcpCb);

  interface = net_if_get_default();
  if (!interface) {
    LOG_ERR("WiFi interface not available");
    return;
  }

  net_dhcpv4_start(interface);
  k_sem_take(&netIfReady, K_FOREVER);
}
```

## src/wifi.h
```c
#ifndef __WIFI_H__
#define __WIFI_H__

void wifiInit();

#endif
```
